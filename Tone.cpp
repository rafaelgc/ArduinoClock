#include "Tone.h"
#include "Arduino.h"

const int Tone::notes[SIZE] = {660,660,660,510,660,770,380,510,380,320,440,480,450,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770,380};
const int Tone::duration[SIZE] = {100,100,100,100,100,100,100,100,100,100,100,80,100,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100,100};
int Tone::silence[SIZE] = {150,300,300,100,300,550,575,450,400,500,300,330,150,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550,575};

Tone::Tone(int buzzerPin){
	this->buzzerPin = buzzerPin;
	currentNote = -1;

	//Hago que los silencios sean más cortos.
	for (unsigned int i = 0; i<SIZE; ++i){
		silence[i]/=1.5;
	}

	loop = false;
}

void Tone::play(bool loop){
	currentNote = 0;
	this->loop = loop;
	if (currentNote!=SIZE){
		tone(buzzerPin, notes[currentNote],duration[currentNote]);
		chrono.restart();
	}
}

void Tone::update(){
	if (currentNote!=-1){
		if (chrono.getElapsedTime()>duration[currentNote]+silence[currentNote]){
			++currentNote;
			if (currentNote==SIZE){
				if (loop){
					currentNote = 0;
				}
				else{
					currentNote = -1;
					return;
				}
			}

			tone(buzzerPin, notes[currentNote], duration[currentNote]);
			chrono.restart();
		}
	}
}

bool Tone::hasFinished(){
	return currentNote==-1;
}

void Tone::stop(){
	currentNote = -1;
}

bool Tone::isPlaying(){
	return currentNote>=0;
}